// SPDX-License-Identifier: (GPL-2.0+ OR MIT)
/*
 * Copyright (c) 2021 Rockchip Electronics Co., Ltd
 *
 */

/dts-v1/;
#include "rk3588.dtsi"
#include "rk3588-u-boot.dtsi"

/ {
	model = "CoolPi 4B";
	compatible = "CoolPi 4B", "rockchip,rk3588";
};
