// SPDX-License-Identifier: (GPL-2.0+ OR MIT)
/*
 * Copyright (c) 2021 Rockchip Electronics Co., Ltd
 *
 */

/dts-v1/;
#include "rk3588s.dtsi"
#include "rk3588s-u-boot.dtsi"
#include <dt-bindings/input/input.h>

/ {
	model = "RK3588S CoolPi 4B Board";
	compatible = "rockchip,rk3588-evb", "rockchip,rk3588";
};
