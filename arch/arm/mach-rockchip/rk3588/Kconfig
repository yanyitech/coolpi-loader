## arch/arm/mach-rockchip/rk3588/Kconfig
```kconfig
if ROCKCHIP_RK3588

config TARGET_EVB_RK3588
	bool "EVB_RK3588"
	select BOARD_LATE_INIT
	help
	  RK3588 EVB is a evaluation board for Rockchp RK3588.

config TARGET_COOLPI_RK3588
	bool "COOLPI_RK3588"
	select BOARD_LATE_INIT

config TARGET_COOLPI_RK3588S
	bool "COOLPI_RK3588S"
	select BOARD_LATE_INIT


config SYS_SOC
	default "rockchip"

config SYS_MALLOC_F_LEN
	default 0x400

source board/rockchip/evb_rk3588/Kconfig
source board/rockchip/coolpi_rk3588/Kconfig
source board/rockchip/coolpi_rk3588s/Kconfig

endif
```

## board/coolpi/coolpi_4b/Kconfig
```kconfig
if TARGET_COOLPI_4B_RK3588

config SYS_BOARD
	default "coolpi_4b"

config SYS_VENDOR
	default "coolpi"

config SYS_CONFIG_NAME
	default "evb_rk3588"

config BOARD_SPECIFIC_OPTIONS # dummy
	def_bool y

endif
```

## board/rockchip/coolpi_rk3588_x8/Kconfig
```kconfig
if TARGET_COOLPI_RK3588_X8

config SYS_BOARD
	default "coolpi_rk3588_x8"

config SYS_VENDOR
	default "rockchip"

config SYS_CONFIG_NAME
	default "coolpi_rk3588_x8"

config BOARD_SPECIFIC_OPTIONS # dummy
	def_bool y

endif
```

## board/rockchip/coolpi_rk3588s/Kconfig
```kconfig
if TARGET_COOLPI_RK3588S

config SYS_BOARD
	default "coolpi_rk3588s"

config SYS_VENDOR
	default "rockchip"

config SYS_CONFIG_NAME
	default "coolpi_rk3588s"

config BOARD_SPECIFIC_OPTIONS # dummy
	def_bool y

endif
```

## board/rockchip/coolpi_rv1106/Kconfig
```kconfig
if TARGET_COOLPI_RV1106

config SYS_BOARD
	default "coolpi_rv1106"

config SYS_VENDOR
	default "rockchip"

config SYS_CONFIG_NAME
	default "coolpi_rv1106"

config BOARD_SPECIFIC_OPTIONS # dummy
	def_bool y

endif
```
